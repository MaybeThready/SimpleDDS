#include "oled.h"
#include "msp_sys.h"
#include <string.h>

uint8_t oled_gram[130][8];

uint32_t oled_pow(uint8_t m, uint8_t n)
{
    uint32_t result = 1;
    while (n--)
        result *= m;
    return result;
}

/**
 *@brief 向OLED写入一个字节
 * 
 * @param data 要写入的数据
 * @param cmd 指示是命令还是数据，非零表示数据，零表示命令
 */
void oled_write_byte(uint8_t data, uint8_t cmd)
{
    if (cmd)
    {
        DL_GPIO_setPins(OLED_DC_PORT, OLED_DC_PIN);
    }
    else
    {
        DL_GPIO_clearPins(OLED_DC_PORT, OLED_DC_PIN);
    }
    DL_GPIO_clearPins(OLED_CS_PORT, OLED_CS_PIN);
    while (DL_SPI_isBusy(OLED_SPI_INST)) { __NOP(); }
    DL_SPI_transmitData8(OLED_SPI_INST, data);
    while (DL_SPI_isBusy(OLED_SPI_INST)) { __NOP(); }
    DL_GPIO_setPins(OLED_CS_PORT, OLED_CS_PIN);
    DL_GPIO_setPins(OLED_DC_PORT, OLED_DC_PIN);
}

/**
 *@brief 打开OLED显示
 *
 */
void oled_display_on()
{
    oled_write_byte(0X8D, OLED_CMD);
    oled_write_byte(0X14, OLED_CMD);
    oled_write_byte(0XAF, OLED_CMD);
}

/**
 *@brief 关闭OLED显示
 * 
 */
void oled_display_off()
{
    oled_write_byte(0X8D, OLED_CMD);
    oled_write_byte(0X10, OLED_CMD);
    oled_write_byte(0XAE, OLED_CMD);
}

/**
 *@brief 清屏函数
 * 
 */
void oled_clear()
{
    uint8_t i, n;
    for (i = 0; i < 8; i++)
    {
        oled_write_byte(0xb0 + i, OLED_CMD);
        oled_write_byte(0x02, OLED_CMD);
        oled_write_byte(0x10, OLED_CMD);
        for (n = 0; n < 128; n++)
            oled_write_byte(0, OLED_DATA);
    }
    memset(oled_gram, 0, sizeof(oled_gram));
}

/**
 *@brief 填充函数。不建议使用该函数
 *
 * @param x1 
 * @param y1 
 * @param x2 
 * @param y2 
 * @param dot 
 */
void oled_fill(uint8_t x1, uint8_t y1, uint8_t x2, uint8_t y2, uint8_t dot)
{
    uint8_t i, m, n;

    if (y1 % 8 == 0)
        m = y1 / 8;
    else
        m = y1 / 8 + 1;
    if (y2 % 8 == 0)
        n = y2 / 8;
    else
        n = y2 / 8 + 1;
    for (i = x1; i <= x2; i++)
    {
        for (uint8_t j = m; j <= n; j++)
        {
            if (dot)
                oled_gram[i][j - 1] |= (0xFF << (y1 % 8)) & (0xFF >> (8 - y2 % 8));
            else
                oled_gram[i][j - 1] &= ~((0xFF << (y1 % 8)) & (0xFF >> (8 - y2 % 8)));
        }
    }
}

/**
 *@brief 显示一个字符
 * 
 * @param x 显示的横坐标，范围0~127
 * @param y 显示的纵坐标，范围0~7
 * @param chr 要显示的字符
 */
void oled_show_char(uint8_t x, uint8_t y, char chr)
{
    unsigned char c = 0, i = 0;
    c = chr - ' ';
    if (x > MAX_COLUMN - 1)
    {
        x = 0;
        y = y + 2;
    }
    if (OLED_SIZE == 16)
    {
        oled_set_pos(x, y);
        for (i = 0; i < 8; i++)
            oled_write_byte(F8X16[c * 16 + i], OLED_DATA);
        oled_set_pos(x, y + 1);
        for (i = 0; i < 8; i++)
            oled_write_byte(F8X16[c * 16 + i + 8], OLED_DATA);
    }
    else
    {
        oled_set_pos(x, y + 1);
        for (i = 0; i < 6; i++)
            oled_write_byte(F6x8[c][i], OLED_DATA);
    }
}

/**
 *@brief 显示数字
 * 
 * @param x 显示的横坐标，范围0~127
 * @param y 显示的纵坐标，范围0~7
 * @param num 要显示的数字
 * @param len 数字的位数
 * @param size2 字体大小
 */
void oled_show_num(uint8_t x, uint8_t y, uint32_t num, uint8_t len, uint8_t size2)
{
    uint8_t t, temp;
    uint8_t enshow = 0;
    for (t = 0; t < len; t++)
    {
        temp = (num / oled_pow(10, len - t - 1)) % 10;
        if (enshow == 0 && t < (len - 1))
        {
            if (temp == 0)
            {
                oled_show_char(x + (size2 / 2) * t, y, ' ');
                continue;
            }
            else
                enshow = 1;
        }
        oled_show_char(x + (size2 / 2) * t, y, temp + '0');
    }
}

/**
 *@brief 显示有符号数字
 * 
 * @param x 显示的横坐标，范围0~127
 * @param y 显示的纵坐标，范围0~7
 * @param num 要显示的有符号数字
 * @param len 数字的位数
 * @param size2 字体大小
 */
void oled_show_signed_num(uint8_t x, uint8_t y, int32_t num, uint8_t len, uint8_t size2)
{
    uint8_t t, temp;
    uint8_t enshow = 0;
    uint8_t isNegative = 0;

    // 判断是否为负数
    if (num < 0)
    {
        isNegative = 1;
        num = -num;  // 转换为正数以便显示
    }

    // 显示负号
    if (isNegative)
    {
        oled_show_char(x, y, '-');
        x += size2 / 2;  // 更新显示位置
        len--;  // 减少一位用于显示负号
    }

    for (t = 0; t < len; t++)
    {
        temp = (num / oled_pow(10, len - t - 1)) % 10;
        if (enshow == 0 && t < (len - 1))
        {
            if (temp == 0)
            {
                oled_show_char(x + (size2 / 2) * t, y, ' ');
                continue;
            }
            else
                enshow = 1;
        }
        oled_show_char(x + (size2 / 2) * t, y, temp + '0');
    }
}

/**
 *@brief 显示字符串
 * 
 * @param x 显示的横坐标，范围0~127
 * @param y 显示的纵坐标，范围0~7
 * @param p 要显示的字符串
 */
void oled_show_string(uint8_t x, uint8_t y, char* p)
{
    unsigned char j = 0;
    while (p[j] != '\0')
    {
        oled_show_char(x, y, p[j]);
        x += 8;
        if (x > 120)
        {
            x = 0;
            y += 2;
        }
        j++;
    }
}

/**
 *@brief 设置坐标
 * 
 * @param this OLED对象指针
 * @param x 显示的横坐标，范围0~127
 * @param y 显示的纵坐标，范围0~7
 */
void oled_set_pos(uint8_t x, uint8_t y)
{
    oled_write_byte(0xb0 + y + YOFFSET, OLED_CMD);
    oled_write_byte(((x & 0xf0) >> 4) | 0x10, OLED_CMD);
    oled_write_byte((x & 0x0f) | 0x01, OLED_CMD);
}

/**
 *@brief 显示汉字
 * 
 * @param x 显示的横坐标，范围0~127
 * @param y 显示的纵坐标，范围0~7
 * @param no 汉字编号
 */
void oled_show_chinese(uint8_t x, uint8_t y, uint8_t no)
{
    uint8_t t;
    oled_set_pos(x, y);
    for (t = 0; t < 16; t++)
    {
        oled_write_byte(Hzk[2 * no][t], OLED_DATA);
    }
    oled_set_pos(x, y + 1);
    for (t = 0; t < 16; t++)
    {
        oled_write_byte(Hzk[2 * no + 1][t], OLED_DATA);
    }
}

/**
 *@brief 显示BMP图片
 * 
 * @param x0 显示的起始横坐标，范围0~127
 * @param y0 显示的起始纵坐标，范围0~7
 * @param x1 显示的结束横坐标，范围0~127
 * @param y1 显示的结束纵坐标，范围0~7
 * @param BMP BMP图片数据数组
 */
void oled_draw_bmp(uint8_t x0, uint8_t y0, uint8_t x1, uint8_t y1, const uint8_t BMP[])
{
    uint16_t j = 0;
    uint8_t x, y;

    if (y1 % 8 == 0)
        y = y1 / 8;
    else
        y = y1 / 8 + 1;
    for (y = y0; y < y1; y++)
    {
        oled_set_pos(x0, y + (!YOFFSET));
        for (x = x0; x < x1; x++)
        {
            oled_write_byte(BMP[j++], OLED_DATA);
        }
    }
}

/**
 *@brief OLED颜色反转
 * 
 * @param i 颜色反转开关，0表示关闭，1表示开启
 */
void oled_color_turn(uint8_t i)
{
    if (i == 0)
    {
        oled_write_byte(0xA6, OLED_CMD);
    }
    if (i == 1)
    {
        oled_write_byte(0xA7, OLED_CMD);
    }
}

/**
 *@brief OLED显示翻转180度
 * 
 * @param i 显示翻转开关，0表示关闭，1表示开启
 */
void oled_display_turn(uint8_t i)
{
    if (i == 0)
    {
        oled_write_byte(0xC8, OLED_CMD);
        oled_write_byte(0xA1, OLED_CMD);
    }
    if (i == 1)
    {
        oled_write_byte(0xC0, OLED_CMD);
        oled_write_byte(0xA0, OLED_CMD);
    }
}

/**
 *@brief 刷新显示
 * 
 * @param this OLED对象指针
 */
void oled_refresh()
{
    uint8_t i, n;
    for (i = 0; i < 8; i++)
    {
        oled_write_byte(0xb0 + i, OLED_CMD);
        oled_write_byte(0x00, OLED_CMD);
        oled_write_byte(0x10, OLED_CMD);
        DL_GPIO_clearPins(OLED_CS_PORT, OLED_CS_PIN);
        delay_cycles(TIME_MS(5));
        while (DL_SPI_isBusy(OLED_SPI_INST)) { __NOP(); };
        DL_SPI_transmitData8(OLED_SPI_INST, 0x78);
        while (DL_SPI_isBusy(OLED_SPI_INST)) { __NOP(); };
        DL_SPI_transmitData8(OLED_SPI_INST, 0x78);
        while (DL_SPI_isBusy(OLED_SPI_INST)) { __NOP(); };
        DL_SPI_transmitData8(OLED_SPI_INST, 0x40);
        for (n = 0; n < 128; n++)
        {
            while (DL_SPI_isBusy(OLED_SPI_INST)) { __NOP(); };
            DL_SPI_transmitData8(OLED_SPI_INST, oled_gram[n][i]);
        }
        delay_cycles(TIME_MS(5));
        DL_GPIO_setPins(OLED_CS_PORT, OLED_CS_PIN);
    }
}

/**
 *@brief 画点函数
 * 
 * @param x 显示的横坐标，范围0~127
 * @param y 显示的纵坐标，范围0~63
 * @param t 点的状态，1表示点亮，0表示熄灭
 */
void oled_draw_point(uint8_t x, uint8_t y, uint8_t t)
{
    uint8_t i, m, n;
    i = y / 8;
    m = y % 8;
    n = 1 << m;
    if (t)
    {
        oled_gram[x][i] |= n;
    }
    else
    {
        oled_gram[x][i] = ~oled_gram[x][i];
        oled_gram[x][i] |= n;
        oled_gram[x][i] = ~oled_gram[x][i];
    }
}

/**
 *@brief 画线函数
 * 
 * @param x1 
 * @param y1 
 * @param x2 
 * @param y2 
 * @param mode 
 */
void oled_draw_line(uint8_t x1, uint8_t y1, uint8_t x2, uint8_t y2, uint8_t mode)
{
    uint16_t t; 
    int xerr = 0, yerr = 0, delta_x, delta_y, distance;
    int incx, incy, uRow, uCol;
    delta_x = x2 - x1;
    delta_y = y2 - y1;
    uRow = x1;
    uCol = y1;
    if (delta_x > 0)incx = 1;
    else if (delta_x == 0)incx = 0;
    else { incx = -1;delta_x = -delta_x; }
    if (delta_y > 0)incy = 1;
    else if (delta_y == 0)incy = 0;
    else { incy = -1;delta_y = -delta_x; }
    if (delta_x > delta_y)distance = delta_x;
    else distance = delta_y;
    for (t = 0;t < distance + 1;t++)
    {
        oled_draw_point(uRow, uCol, mode);
        xerr += delta_x;
        yerr += delta_y;
        if (xerr > distance)
        {
            xerr -= distance;
            uRow += incx;
        }
        if (yerr > distance)
        {
            yerr -= distance;
            uCol += incy;
        }
    }
}

/**
 *@brief 画圆函数
 * 
 * @param x 
 * @param y 
 * @param r 
 */
void oled_draw_circle(uint8_t x, uint8_t y, uint8_t r)
{
    int a, b, num;
    a = 0;
    b = r;
    while (2 * b * b >= r * r)
    {
        oled_draw_point(x + a, y - b, 1);
        oled_draw_point(x - a, y - b, 1);
        oled_draw_point(x - a, y + b, 1);
        oled_draw_point(x + a, y + b, 1);

        oled_draw_point(x + b, y + a, 1);
        oled_draw_point(x + b, y - a, 1);
        oled_draw_point(x - b, y - a, 1);
        oled_draw_point(x - b, y + a, 1);

        a++;
        num = (a * a + b * b) - r * r;
        if (num > 0)
        {
            b--;
            a--;
        }
    }
}

void init_oled()
{
    DL_GPIO_setPins(OLED_RES_PORT, OLED_RES_PIN);
	delay_cycles(TIME_MS(100));
	DL_GPIO_clearPins(OLED_RES_PORT, OLED_RES_PIN);
	delay_cycles(TIME_MS(100));
    DL_GPIO_setPins(OLED_RES_PORT, OLED_RES_PIN);
    delay_cycles(TIME_MS(100));

	oled_write_byte(0xAE, OLED_CMD);
	oled_write_byte(0x02, OLED_CMD);
	oled_write_byte(0x10, OLED_CMD);
	oled_write_byte(0x40, OLED_CMD);
    oled_write_byte(0x81, OLED_CMD);
    oled_write_byte(0xCF, OLED_CMD);
	oled_write_byte(0xA1, OLED_CMD);
	oled_write_byte(0xC8, OLED_CMD);
    oled_write_byte(0xA6, OLED_CMD);
    oled_write_byte(0xA8, OLED_CMD);
    oled_write_byte(0x3f, OLED_CMD);
	oled_write_byte(0xD3, OLED_CMD);
    oled_write_byte(0x00, OLED_CMD);
	oled_write_byte(0xd5, OLED_CMD);
	oled_write_byte(0x80, OLED_CMD);
    oled_write_byte(0xD9, OLED_CMD);
	oled_write_byte(0xF1, OLED_CMD);
    oled_write_byte(0xDA, OLED_CMD);
    oled_write_byte(0x12, OLED_CMD);
    oled_write_byte(0xDB, OLED_CMD);
    oled_write_byte(0x40, OLED_CMD);
	oled_write_byte(0x20, OLED_CMD);
    oled_write_byte(0x02, OLED_CMD);
	oled_write_byte(0x8D, OLED_CMD);
    oled_write_byte(0x14, OLED_CMD);
	oled_write_byte(0xA4, OLED_CMD);
	oled_write_byte(0xA6, OLED_CMD);
	oled_write_byte(0xAF, OLED_CMD);
	
	oled_write_byte(0xAF, OLED_CMD);
    oled_clear();
    oled_display_on();
    oled_set_pos(0, 0);
}

// 常用ASCII表
// 偏移量32
// ASCII字符集
// 偏移量32
// 大小:12*6
/************************************6*8的点阵************************************/
const unsigned char  F6x8[][6] =
{
    0x00, 0x00, 0x00, 0x00, 0x00, 0x00, // sp
    0x00, 0x00, 0x00, 0x2f, 0x00, 0x00, // !
    0x00, 0x00, 0x07, 0x00, 0x07, 0x00, // "
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    0x14, 0x14, 0x14, 0x14, 0x14, 0x14, // horiz lines
};

/****************************************8*16的点阵************************************/
const unsigned char  F8X16[] =
{
    0x00, 0x00, 0x00, 0x00, 0x00, 0x00, 0x00, 0x00, 0x00, 0x00, 0x00, 0x00, 0x00, 0x00, 0x00, 0x00, // 0
    0x00, 0x00, 0x00, 0xF8, 0x00, 0x00, 0x00, 0x00, 0x00, 0x00, 0x00, 0x33, 0x30, 0x00, 0x00, 0x00, // ! 1
    0x00, 0x10, 0x0C, 0x06, 0x10, 0x0C, 0x06, 0x00, 0x00, 0x00, 0x00, 0x00, 0x00, 0x00, 0x00, 0x00, // " 2
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    0xff, 0xff, 0xff, 0xff, 0xff, 0xff, 0xff, 0xff, 0xff, 0xff, 0xff, 0xff, 0xff, 0xff, 0xff, 0xff, // ~ 94
};
const unsigned char  Hzk[][32] =
{
    /*--  文字:  零  --*/
    /*--  幼圆12;  此字体下对应的点阵为：宽x高=16x16   --*/
    {0x70, 0x7E, 0xFE, 0xFE, 0xFE, 0xFE, 0xFE, 0xFE, 0xFE, 0xFE, 0xFE, 0xFE, 0xFE, 0xFE, 0x78, 0x30},
    {0x04, 0x1E, 0x1E, 0x1A, 0x7B, 0x7B, 0xDB, 0xDF, 0xDD, 0xDF, 0x7B, 0x7A, 0x3E, 0x16, 0x04, 0x04},

    /*--  文字:  壹  --*/
    /*--  幼圆12;  此字体下对应的点阵为：宽x高=16x16   --*/
    {0x80, 0xC4, 0xFC, 0xFC, 0xFC, 0xFC, 0xFC, 0xFE, 0xFE, 0xFC, 0xFC, 0xFC, 0xFC, 0xFC, 0xC4, 0x00},
    {0x83, 0x83, 0x9F, 0x9F, 0xBF, 0xF7, 0xF7, 0xB7, 0xB7, 0xF7, 0xF7, 0xBF, 0x9F, 0x9F, 0x83, 0x00},

    /*--  文字:  贰  --*/
    /*--  幼圆12;  此字体下对应的点阵为：宽x高=16x16   --*/
    {0x48, 0x7C, 0x7C, 0xFC, 0xFC, 0xFC, 0xFC, 0xFC, 0xFC, 0x7C, 0xFE, 0xFE, 0x0E, 0x1E, 0x1C, 0x00},
    {0x80, 0x80, 0xDF, 0xDF, 0x61, 0x7F, 0x3F, 0x61, 0x7F, 0xDF, 0xDF, 0xBF, 0xFF, 0xE0, 0xF0, 0x00},

    /*--  文字:  叁  --*/
    /*--  幼圆12;  此字体下对应的点阵为：宽x高=16x16   --*/
    {0x80, 0x80, 0x80, 0xB0, 0xB8, 0xBC, 0xFE, 0xF6, 0xB0, 0xB0, 0xBC, 0xBC, 0xB8, 0xF0, 0xE0, 0x00},
    {0x88, 0x98, 0x8C, 0xBC, 0xB6, 0xB7, 0xB7, 0xB4, 0xB4, 0xB7, 0xB7, 0xB6, 0xBC, 0x8C, 0x98, 0x00},

    /*--  文字:  肆  --*/
    /*--  幼圆12;  此字体下对应的点阵为：宽x高=16x16   --*/
    {0x00, 0xFC, 0xFC, 0xB4, 0xB4, 0xB4, 0x24, 0x6C, 0x6C, 0xFE, 0xFE, 0xFE, 0x6C, 0xFC, 0xF8, 0x00},
    {0xC4, 0xF7, 0xFF, 0xDD, 0x55, 0x75, 0xF5, 0xFD, 0x3D, 0xFF, 0xFF, 0xFF, 0x3D, 0x3D, 0x35, 0x00},

    /*--  文字:  伍  --*/
    /*--  幼圆12;  此字体下对应的点阵为：宽x高=16x16   --*/
    {0x00, 0xC0, 0xFE, 0xFE, 0x86, 0x84, 0x84, 0xF4, 0xFC, 0xBC, 0x84, 0x84, 0x84, 0x84, 0x04, 0x00},
    {0x03, 0x03, 0xFF, 0xFF, 0xC0, 0xC0, 0xF0, 0xFF, 0xFF, 0xC0, 0xC0, 0xC0, 0xFF, 0xFF, 0xC0, 0x00},

    /*--  文字:  陆  --*/
    /*--  幼圆12;  此字体下对应的点阵为：宽x高=16x16   --*/
    {0xF8, 0xFC, 0xFC, 0xFC, 0xFC, 0x9C, 0x98, 0x98, 0x98, 0xFE, 0xFE, 0x98, 0x98, 0x98, 0x90, 0x00},
    {0xFF, 0xFF, 0xFF, 0x1B, 0x1F, 0x7F, 0xFF, 0xC1, 0xC1, 0xFF, 0xFF, 0xC1, 0xFF, 0xFF, 0x7F, 0x00},

    /*--  文字:  柒  --*/
    /*--  幼圆12;  此字体下对应的点阵为：宽x高=16x16   --*/
    {0x10, 0x12, 0x36, 0xBE, 0xEC, 0xD8, 0x50, 0x10, 0xFE, 0xFE, 0x18, 0x18, 0x18, 0xD8, 0xD8, 0x00},
    {0x82, 0xC7, 0xC7, 0x65, 0x64, 0x34, 0x1C, 0xFE, 0xFF, 0x1D, 0x35, 0x65, 0x65, 0xC5, 0xC5, 0x00},

    /*--  文字:  捌  --*/
    /*--  幼圆12;  此字体下对应的点阵为：宽x高=16x16   --*/
    {0x10, 0x30, 0xFE, 0xFE, 0x30, 0xFC, 0xFC, 0xC4, 0xC4, 0xFC, 0xFC, 0xF8, 0xFC, 0xFC, 0xFC, 0x00},
    {0xC4, 0x84, 0xFF, 0xFF, 0xC3, 0xF3, 0xFF, 0xDF, 0x82, 0xFE, 0xFE, 0xBF, 0xBF, 0xFF, 0xFF, 0x00},

    /*--  文字:  玖  --*/
    /*--  幼圆12;  此字体下对应的点阵为：宽x高=16x16   --*/
    {0x00, 0x8C, 0x8C, 0xFC, 0xFC, 0x8C, 0x08, 0xE0, 0xFE, 0x3E, 0x1A, 0xD8, 0xF8, 0x70, 0x00, 0x00},
    {0x41, 0x41, 0x61, 0x7F, 0x3F, 0xB1, 0xDB, 0xFB, 0x70, 0x38, 0x1E, 0x07, 0x1F, 0x7C, 0xF0, 0x00},

    //10
    /*--  文字:  原  --*/
    /*--  幼圆12;  此字体下对应的点阵为：宽x高=16x16   --*/
    {0x00, 0xFC, 0xFE, 0xF6, 0xF6, 0xD6, 0xD6, 0xDE, 0xDE, 0xDE, 0xD6, 0xD6, 0xD6, 0xF6, 0xF6, 0x00},
    {0xE0, 0xFF, 0xFF, 0xE3, 0x77, 0xBE, 0x9E, 0x86, 0xFE, 0xFE, 0x06, 0x1E, 0x3E, 0xF7, 0xE3, 0x00},

    //11
    /*--  文字:  神  --*/
    /*--  幼圆12;  此字体下对应的点阵为：宽x高=16x16   --*/
    {0x10, 0x10, 0x16, 0x9E, 0xFC, 0xF0, 0xF0, 0xF8, 0x98, 0x98, 0xFE, 0xFE, 0x98, 0xF8, 0xF0, 0x00},
    {0x0C, 0x0E, 0xFF, 0xFF, 0xFF, 0x07, 0x1F, 0x1F, 0x11, 0x11, 0xFF, 0xFF, 0x11, 0x1F, 0x1F, 0x00},

    //12
    /*--  文字:  启  --*/
    /*--  幼圆12;  此字体下对应的点阵为：宽x高=16x16   --*/
    {0x00, 0xF8, 0xF8, 0xC8, 0xC8, 0xC8, 0xCE, 0xCE, 0xCC, 0xC8, 0xC8, 0xC8, 0xF8, 0xF8, 0x70, 0x00},
    {0xE0, 0xFF, 0x3F, 0xFE, 0xFE, 0x82, 0x82, 0x82, 0x82, 0x82, 0x82, 0x82, 0x82, 0xFE, 0xFE, 0x00},

    //13
    /*--  文字:  动  --*/
    /*--  幼圆12;  此字体下对应的点阵为：宽x高=16x16   --*/
    {0x80, 0x88, 0x98, 0x98, 0x98, 0x98, 0x98, 0x88, 0xB0, 0x30, 0xFE, 0xFE, 0x30, 0x30, 0xF0, 0xE0},
    {0x00, 0x60, 0x7C, 0x7F, 0x67, 0x6C, 0x7C, 0xF8, 0xE0, 0xFC, 0xBF, 0x87, 0x80, 0xE0, 0xFF, 0x3F},

    //14
    /*--  文字:  ，  --*/
    /*--  幼圆12;  此字体下对应的点阵为：宽x高=16x16   --*/
    {0x00, 0x00, 0x00, 0x00, 0x00, 0x00, 0x00, 0x00, 0x00, 0x00, 0x00, 0x00, 0x00, 0x00, 0x00, 0x00},
    {0x00, 0xF0, 0xF0, 0xF0, 0x60, 0x00, 0x00, 0x00, 0x00, 0x00, 0x00, 0x00, 0x00, 0x00, 0x00, 0x00},

    //15
    /*--  文字:  。  --*/
    /*--  幼圆12;  此字体下对应的点阵为：宽x高=16x16   --*/
    {0x00, 0x00, 0x00, 0x00, 0x00, 0x00, 0x00, 0x00, 0x00, 0x00, 0x00, 0x00, 0x00, 0x00, 0x00, 0x00},
    {0x30, 0x78, 0xC8, 0xC8, 0x78, 0x30, 0x00, 0x00, 0x00, 0x00, 0x00, 0x00, 0x00, 0x00, 0x00, 0x00},

    //16
    /*--  文字:  ！  --*/
    /*--  幼圆12;  此字体下对应的点阵为：宽x高=16x16   --*/
    {0x00, 0x00, 0x00, 0xF8, 0xF8, 0xF8, 0x00, 0x00, 0x00, 0x00, 0x00, 0x00, 0x00, 0x00, 0x00, 0x00},
    {0x00, 0x00, 0x00, 0x6F, 0x6F, 0x6F, 0x00, 0x00, 0x00, 0x00, 0x00, 0x00, 0x00, 0x00, 0x00, 0x00},

    //17
    /*--  文字:  ？  --*/
    /*--  幼圆12;  此字体下对应的点阵为：宽x高=16x16   --*/
    {0x00, 0x00, 0x00, 0x00, 0x00, 0x70, 0x78, 0x58, 0xB8, 0xF8, 0xF0, 0x40, 0x00, 0x00, 0x00, 0x00},
    {0x00, 0x00, 0x00, 0x00, 0x00, 0x00, 0x00, 0x6E, 0x6F, 0x63, 0x01, 0x00, 0x00, 0x00, 0x00, 0x00},

    //18
    /*--  文字:  「  --*/
    /*--  幼圆12;  此字体下对应的点阵为：宽x高=16x16   --*/
    {0x00, 0x00, 0x00, 0x00, 0x00, 0x00, 0x00, 0x00, 0x00, 0x00, 0xF8, 0xF8, 0x18, 0x18, 0x18, 0x00},
    {0x00, 0x00, 0x00, 0x00, 0x00, 0x00, 0x00, 0x00, 0x00, 0x00, 0x7F, 0x3F, 0x00, 0x00, 0x00, 0x00},

    //19
    /*--  文字:  」  --*/
    /*--  幼圆12;  此字体下对应的点阵为：宽x高=16x16   --*/
    {0x00, 0x00, 0x00, 0x00, 0xF0, 0xF8, 0xF8, 0x00, 0x00, 0x00, 0x00, 0x00, 0x00, 0x00, 0x00, 0x00},
    {0x00, 0x20, 0x60, 0x60, 0x7F, 0x7F, 0x3F, 0x00, 0x00, 0x00, 0x00, 0x00, 0x00, 0x00, 0x00, 0x00},

    //20
    /*--  文字:  刘  --*/
    /*--  新宋体12;  此字体下对应的点阵为：宽x高=16x16   --*/
    {0x08, 0x28, 0x48, 0x89, 0x0E, 0x88, 0x78, 0x08, 0x08, 0x00, 0xF8, 0x00, 0x00, 0xFF, 0x00, 0x00},
    {0x40, 0x20, 0x10, 0x09, 0x06, 0x19, 0x60, 0x00, 0x00, 0x00, 0x0F, 0x40, 0x80, 0x7F, 0x00, 0x00},

    //21
    /*--  文字:  振  --*/
    /*--  新宋体12;  此字体下对应的点阵为：宽x高=16x16   --*/
    {0x10, 0x10, 0x10, 0xFF, 0x10, 0x90, 0xFE, 0x82, 0x92, 0x92, 0x92, 0x92, 0x92, 0x82, 0x00, 0x00},
    {0x04, 0x44, 0x82, 0x7F, 0x81, 0x60, 0x1F, 0x00, 0xFF, 0x80, 0x47, 0x18, 0x24, 0x42, 0x80, 0x00},

    //22
    /*--  文字:  宇  --*/
    /*--  新宋体12;  此字体下对应的点阵为：宽x高=16x16   --*/
    {0x10, 0x0C, 0x24, 0x24, 0x24, 0x24, 0x25, 0xE6, 0x24, 0x24, 0x24, 0x24, 0x24, 0x14, 0x0C, 0x00},
    {0x02, 0x02, 0x02, 0x02, 0x02, 0x42, 0x82, 0x7F, 0x02, 0x02, 0x02, 0x02, 0x02, 0x02, 0x02, 0x00},

    //23
    /*--  文字:  鼎  --*/
    /*--  新宋体12;  此字体下对应的点阵为：宽x高=16x16   --*/
    {0x00, 0xF8, 0x00, 0x00, 0x7F, 0x55, 0x55, 0x55, 0x55, 0x55, 0x7F, 0x00, 0x00, 0xF8, 0x00, 0x00},
    {0x88, 0x49, 0x39, 0x09, 0x09, 0xFF, 0x00, 0x00, 0x00, 0xFF, 0x09, 0x09, 0x09, 0xF9, 0x00, 0x00},

    //24
    /*--  文字:  琨  --*/
    /*--  新宋体12;  此字体下对应的点阵为：宽x高=16x16   --*/
    {0x04, 0x84, 0x84, 0xFC, 0x84, 0x84, 0x00, 0xFE, 0x92, 0x92, 0x92, 0x92, 0x92, 0xFE, 0x00, 0x00},
    {0x20, 0x60, 0x20, 0x1F, 0x10, 0x10, 0x00, 0xFE, 0x44, 0x24, 0x00, 0x7E, 0x88, 0x84, 0xE2, 0x00},

    //25
    /*--  文字:  宋  --*/
    /*--  新宋体12;  此字体下对应的点阵为：宽x高=16x16   --*/
    {0x10, 0x8C, 0x84, 0x84, 0x84, 0x84, 0x85, 0xF6, 0x84, 0x84, 0x84, 0x84, 0x84, 0x94, 0x0C, 0x00},
    {0x20, 0x20, 0x10, 0x08, 0x04, 0x02, 0x01, 0xFF, 0x01, 0x02, 0x04, 0x08, 0x10, 0x20, 0x20, 0x00},

    //26
    /*--  文字:  琪  --*/
    /*--  新宋体12;  此字体下对应的点阵为：宽x高=16x16   --*/
    {0x84, 0x84, 0xFC, 0x84, 0x84, 0x00, 0x04, 0xFF, 0x24, 0x24, 0x24, 0x24, 0xFF, 0x04, 0x00, 0x00},
    {0x10, 0x30, 0x1F, 0x08, 0x08, 0x00, 0x88, 0x4F, 0x29, 0x09, 0x09, 0x29, 0x4F, 0x88, 0x08, 0x00}

};
